/* ============================================================
 * ai_inject_test  —  add to app_x-cube-ai.c (USER CODE area)
 *
 * Bypass real ADC and P&O. Inject MATLAB-generated ADC raw counts,
 * run inference, decode V_GMPP, compare against ground truth.
 *
 * Reuses existing static helpers: quantize(), aiRun(),
 * stai_input[], stai_output[], LC_PRINT, SCB_CleanDCache_by_Addr.
 * ============================================================ */

#include "test_vectors.h"   /* generated by pv_gen_test_vectors.m */

/* ---- ADC front-end constants (match schematic) ---- */
/* V path: PANEL+ -> R45/R43 -> ARD_A0R -> R156/R155 -> TSZ122 follower -> ADC */
#define FE_DIV_USER   (2.2f/(80.6f+2.2f))     /* your board R43/(R45+R43) ~0.02657 */
#define FE_DIV_BOARD  (560.0f/(470.0f+560.0f))/* Nucleo A0 R155/(R156+R155) ~0.5437 */
#define FE_VOP_GAIN   1.0f                     /* U7A TSZ122 = unity follower */
#define FE_VOP_OFF    0.0f                     /* follower offset [V] */
/* I path: PANEL+ shunt -> INA241 -> ADC */
#define FE_RSHUNT     0.001f                   /* R1 */
#define FE_INA_GAIN   200.0f                   /* INA241A4  <-- verify variant */
#define FE_IDIV_BOARD 1.0f                     /* set to FE_DIV_BOARD if I also uses a buffered Arduino pin */
/* shared ADC */
#define FE_VREF       1.8f                     /* VDDA1V8 -> VREF+ ~1.8V (NOT 3.3). confirm board */
#define FE_ADC_FS     4095.0f
#define PV_VOC_NOM    62.976f                  /* 0.656 * 32 * 3 */
#define PV_ISC_NOM    6.05f

/* output tensor dequant  <-- VERIFY against your .tflite output quant params.
 * Firmware currently hardcodes (q+128)/256, i.e. scale=1/256, zp=-128. */
#define OUT_SCALE  0.00390625f
#define OUT_ZP     (-128)

/* raw[] layout per point = [rawI, rawV] (DMA rank1=ch5=I, rank2=ch10=V) */
static void tv_fill_input(const uint16_t *raw) {
    int8_t *in = (int8_t*) stai_input[0];
    for (int i = 0; i < TV_N_SCAN; i++) {
        uint16_t rawI = raw[i * 2];
        uint16_t rawV = raw[i * 2 + 1];

        /* V: raw -> pin volts -> undo follower -> undo both dividers -> normalize */
        float vpin    = (rawV / FE_ADC_FS) * FE_VREF;
        float v_panel = (vpin - FE_VOP_OFF) / (FE_DIV_USER * FE_DIV_BOARD * FE_VOP_GAIN);
        float v_norm  = v_panel / PV_VOC_NOM;

        /* I: raw -> pin volts -> undo INA241 (+board divider if any) -> normalize */
        float ipin    = (rawI / FE_ADC_FS) * FE_VREF;
        float i_panel = ipin / (FE_RSHUNT * FE_INA_GAIN * FE_IDIV_BOARD);
        float i_norm  = i_panel / PV_ISC_NOM;

        in[i * 2]     = quantize(v_norm);          /* model order: V first */
        in[i * 2 + 1] = quantize(i_norm);          /*              I second */
    }
    SCB_CleanDCache_by_Addr((uint32_t*) in, TV_N_SCAN * 2);
}

void ai_inject_test(void) {
    uint32_t arr = htim1.Instance->ARR;
    LC_PRINT("---- inject test (no ADC, no P&O) ----\r\n");

    HAL_TIM_PWM_Start(&htim1, PWM_TEST_CH);
    /* 보완출력(CHxN)이면 위 대신: HAL_TIMEx_PWMN_Start(&htim1, PWM_TEST_CH); */

    for (int s = 0; s < TV_COUNT; s++) {
        tv_fill_input(tv_adc[s]);
        aiRun();

        int8_t q   = ((int8_t*) stai_output[0])[0];
        float vpred = (q - OUT_ZP) * OUT_SCALE;     /* V_GMPP/Voc_nom */
        float vtrue = tv_vgmpp_norm[s];

        /* 예측 정규화전압 -> duty (원래 post_process와 동일 매핑: duty = vpred * ARR) */
        int32_t duty = (int32_t) (vpred * (float) arr);
        if (duty < DUTY_MIN) duty = DUTY_MIN;
        if (duty > DUTY_MAX) duty = DUTY_MAX;
        __HAL_TIM_SET_COMPARE(&htim1, PWM_TEST_CH, (uint32_t) duty);

        LC_PRINT("scen %d: pred=%.4f (%.2fV)  true=%.4f (%.2fV)  err=%.2fV  duty=%ld/%lu (%.0f%%)\r\n",
                 s, vpred, vpred * PV_VOC_NOM,
                 vtrue, vtrue * PV_VOC_NOM,
                 (vpred - vtrue) * PV_VOC_NOM,
                 (long) duty, (unsigned long) arr, 100.0f * duty / arr);

        BSP_LED_Toggle(LED_BLUE);
        HAL_Delay(3000);   /* 이 시나리오 duty 유지 — 스코프로 확인 */
    }
    /* 마지막 시나리오 duty 그대로 유지 (Process가 idle) */
}

/* ---- PWM output check (scope the pin) ---- */
/* set to the channel actually wired to your output pin.
 * NOTE: acquire uses CH2 but MPPT_PWM_CH uses CH1 in app_x-cube-ai.c — reconcile. */
#ifndef PWM_TEST_CH
#define PWM_TEST_CH  TIM_CHANNEL_1
#endif

void pwm_test(void) {
    uint32_t arr = htim1.Instance->ARR;
    LC_PRINT("pwm_test: ARR=%lu, sweep duty 10..90%%\r\n", (unsigned long) arr);

    HAL_TIM_PWM_Start(&htim1, PWM_TEST_CH);
    /* 보완출력(CHxN)이면 위 대신: HAL_TIMEx_PWMN_Start(&htim1, PWM_TEST_CH); */

    while (1) {
        for (int pct = 10; pct <= 90; pct += 10) {
            uint32_t ccr = (uint32_t) ((uint64_t) arr * pct / 100);
            __HAL_TIM_SET_COMPARE(&htim1, PWM_TEST_CH, ccr);
            LC_PRINT("duty=%d%% (CCR=%lu / ARR=%lu)\r\n",
                     pct, (unsigned long) ccr, (unsigned long) arr);
            BSP_LED_Toggle(LED_BLUE);
            HAL_Delay(1000);
        }
    }
}

/* In STM32CubeAI_Studio_AI_Process(): call ai_inject_test() or pwm_test(). */
